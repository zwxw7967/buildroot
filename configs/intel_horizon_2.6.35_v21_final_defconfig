## configs/intel_horizon_2.6.35_v21_final_defconfig
```kconfig
BR2_x86_i686=y
BR2_CCACHE=y
BR2_OPTIMIZE_2=y
BR2_TOOLCHAIN_EXTERNAL=y
BR2_TOOLCHAIN_EXTERNAL_CUSTOM=y
BR2_TOOLCHAIN_EXTERNAL_PATH="/opt/i686_gcc_x86_linux_01/i686-linux-elf"
BR2_TOOLCHAIN_EXTERNAL_CUSTOM_PREFIX="i686-buildroot-linux-gnu"
BR2_TOOLCHAIN_EXTERNAL_GCC_4_9=y
BR2_TOOLCHAIN_EXTERNAL_CUSTOM_GLIBC=y
BR2_TOOLCHAIN_EXTERNAL_CXX=y
BR2_ENABLE_LOCALE_PURGE=y
BR2_ENABLE_LOCALE_WHITELIST="C en_US"
BR2_TARGET_GENERIC_CABUNDLE=y
BR2_ROOTFS_DEVICE_CREATION_DYNAMIC_EUDEV=y
BR2_TARGET_GENERIC_ROOT_PASSWD="root"
BR2_TARGET_GENERIC_GETTY_PORT="tty1"
BR2_SYSTEM_DHCP="eth0"
BR2_LINUX_KERNEL=y
BR2_LINUX_KERNEL_CUSTOM_GIT=y
BR2_LINUX_KERNEL_CUSTOM_REPO_URL="git@github.com:Metrological/intelce-linux-2.6.git"
BR2_LINUX_KERNEL_CUSTOM_REPO_VERSION="horizon3.4"
BR2_LINUX_KERNEL_USE_CUSTOM_CONFIG=y
BR2_LINUX_KERNEL_CUSTOM_CONFIG_FILE="board/intel/intelce/linuxce-2.6.35.config "
BR2_PACKAGE_BUSYBOX_SMP=y
BR2_PACKAGE_GSTREAMER1=y
BR2_PACKAGE_GST1_PLUGINS_BASE_PLUGIN_APP=y
BR2_PACKAGE_GST1_PLUGINS_BASE_PLUGIN_VIDEOCONVERT=y
BR2_PACKAGE_GST1_PLUGINS_BASE_PLUGIN_GIO=y
BR2_PACKAGE_GST1_PLUGINS_GOOD_PLUGIN_AUDIOFX=y
BR2_PACKAGE_GST1_PLUGINS_GOOD_PLUGIN_AUDIOPARSERS=y
BR2_PACKAGE_GST1_PLUGINS_GOOD_PLUGIN_AUTODETECT=y
BR2_PACKAGE_GST1_PLUGINS_GOOD_PLUGIN_DEINTERLACE=y
BR2_PACKAGE_GST1_PLUGINS_GOOD_PLUGIN_INTERLEAVE=y
BR2_PACKAGE_GST1_PLUGINS_GOOD_PLUGIN_SOUPHTTPSRC=y
BR2_PACKAGE_GST1_PLUGINS_BAD_PLUGIN_MPEGTSDEMUX=y
BR2_PACKAGE_GST1_PLUGINS_BAD_PLUGIN_VIDEOPARSERS=y
BR2_PACKAGE_GST1_PLUGINS_BAD_PLUGIN_DASH=y
BR2_PACKAGE_GST1_PLUGINS_BAD_PLUGIN_FAAD=y
BR2_PACKAGE_GST1_PLUGINS_BAD_PLUGIN_MPG123=y
BR2_PACKAGE_GST1_PLUGINS_BAD_PLUGIN_SMOOTHSTREAMING=y
BR2_PACKAGE_GST1_PLUGINS_BAD_PLUGIN_HLS=y
BR2_PACKAGE_NINJA=y
BR2_PACKAGE_BITSTREAM_VERA=y
BR2_PACKAGE_INTELCE_SDK=y
BR2_PACKAGE_INTELCE_LOADDRIVERS=y
BR2_PACKAGE_INTELCE_SDK_V21=y
BR2_PACKAGE_INTELCE_CONFIG_DATABASE=y
BR2_PACKAGE_INTELCE_DEMUX=y
BR2_PACKAGE_INTELCE_EDL=y
BR2_PACKAGE_INTELCE_MUX=y
BR2_PACKAGE_INTELCE_PIC24=y
BR2_PACKAGE_INTELCE_PIC24_UART=y
BR2_PACKAGE_INTELCE_PIC24_UART_DRV=y
BR2_PACKAGE_INTELCE_REMUX=y
BR2_PACKAGE_INTELCE_TSOUT=y
BR2_PACKAGE_INTELCE_VIDDEC=y
BR2_PACKAGE_INTELCE_VIDENC=y
BR2_PACKAGE_INTELCE_VIDSINK=y
BR2_PACKAGE_JPEG_TURBO=y
BR2_PACKAGE_WPE=y
BR2_PACKAGE_WPE_USE_PUNCH_HOLE_GSTREAMER=y
BR2_PACKAGE_LIBCURL=y
BR2_PACKAGE_CPPSDK_DEBUG=y
BR2_PACKAGE_ICU_USE_ICUDATA=y
BR2_PACKAGE_DROPBEAR=y
BR2_PACKAGE_WEBBRIDGE=y
BR2_PACKAGE_PLUGIN_TRACECONTROL=y
BR2_PACKAGE_PLUGIN_DICTIONARY=y
BR2_PACKAGE_PLUGIN_DELAYEDRESPONSE=y
BR2_PACKAGE_PLUGIN_WEBPROXY=y
BR2_PACKAGE_PLUGIN_REMOTECONTROL=y
BR2_PACKAGE_PLUGIN_TEMPCONTROL=y
BR2_PACKAGE_PLUGIN_FILESERVER=y
BR2_PACKAGE_PLUGIN_DEVICEINFO=y
BR2_PACKAGE_PLUGIN_WEBKITBROWSER=y
BR2_PACKAGE_PLUGIN_DIALSERVER=y
```

## configs/intel_horizon_qt_defconfig
```kconfig
BR2_x86_i686=y
BR2_CCACHE=y
BR2_OPTIMIZE_2=y
BR2_TOOLCHAIN_EXTERNAL=y
BR2_TOOLCHAIN_EXTERNAL_CUSTOM=y
BR2_TOOLCHAIN_EXTERNAL_PATH="/opt/i686_gcc_x86_linux_01/i686-linux-elf"
BR2_TOOLCHAIN_EXTERNAL_CUSTOM_PREFIX="i686-buildroot-linux-gnu"
BR2_TOOLCHAIN_EXTERNAL_GCC_4_9=y
BR2_TOOLCHAIN_EXTERNAL_CUSTOM_GLIBC=y
BR2_TOOLCHAIN_EXTERNAL_CXX=y
BR2_PACKAGE_HOST_GDB=y
BR2_GDB_VERSION_7_8=y
BR2_ENABLE_LOCALE_PURGE=y
BR2_ENABLE_LOCALE_WHITELIST="C en_US"
BR2_TARGET_GENERIC_CABUNDLE=y
BR2_ROOTFS_DEVICE_CREATION_DYNAMIC_EUDEV=y
BR2_TARGET_GENERIC_ROOT_PASSWD="root"
BR2_TARGET_GENERIC_GETTY_PORT="ttyS0"
BR2_SYSTEM_DHCP="eth0"
BR2_LINUX_KERNEL=y
BR2_LINUX_KERNEL_CUSTOM_GIT=y
BR2_LINUX_KERNEL_CUSTOM_REPO_URL="git@github.com:Metrological/intelce-linux-2.6.git"
BR2_LINUX_KERNEL_CUSTOM_REPO_VERSION="horizon3.4"
BR2_LINUX_KERNEL_USE_CUSTOM_CONFIG=y
BR2_LINUX_KERNEL_CUSTOM_CONFIG_FILE="board/intel/intelce/linuxce-2.6.35-debug.config "
BR2_PACKAGE_BUSYBOX_SMP=y
BR2_PACKAGE_QTTESTS=y
BR2_PACKAGE_GSTREAMER1=y
BR2_PACKAGE_GST1_PLUGINS_BASE_PLUGIN_APP=y
BR2_PACKAGE_GST1_PLUGINS_BASE_PLUGIN_VIDEOCONVERT=y
BR2_PACKAGE_GST1_PLUGINS_BASE_PLUGIN_GIO=y
BR2_PACKAGE_GST1_PLUGINS_GOOD_PLUGIN_AUDIOFX=y
BR2_PACKAGE_GST1_PLUGINS_GOOD_PLUGIN_AUDIOPARSERS=y
BR2_PACKAGE_GST1_PLUGINS_GOOD_PLUGIN_AUTODETECT=y
BR2_PACKAGE_GST1_PLUGINS_GOOD_PLUGIN_DEINTERLACE=y
BR2_PACKAGE_GST1_PLUGINS_GOOD_PLUGIN_INTERLEAVE=y
BR2_PACKAGE_GST1_PLUGINS_GOOD_PLUGIN_SOUPHTTPSRC=y
BR2_PACKAGE_GST1_PLUGINS_BAD_PLUGIN_MPEGTSDEMUX=y
BR2_PACKAGE_GST1_PLUGINS_BAD_PLUGIN_VIDEOPARSERS=y
BR2_PACKAGE_GST1_PLUGINS_BAD_PLUGIN_DASH=y
BR2_PACKAGE_GST1_PLUGINS_BAD_PLUGIN_FAAD=y
BR2_PACKAGE_GST1_PLUGINS_BAD_PLUGIN_MPG123=y
BR2_PACKAGE_GST1_PLUGINS_BAD_PLUGIN_SMOOTHSTREAMING=y
BR2_PACKAGE_GST1_PLUGINS_BAD_PLUGIN_HLS=y
BR2_PACKAGE_NINJA=y
BR2_PACKAGE_DXDRM=y
BR2_PACKAGE_BITSTREAM_VERA=y
BR2_PACKAGE_QT5=y
BR2_PACKAGE_QT5BASE_LICENSE_APPROVED=y
BR2_PACKAGE_QT5BASE_CONCURRENT=y
BR2_PACKAGE_QT5BASE_MYSQL=y
BR2_PACKAGE_QT5BASE_OPENGL_LIB=y
BR2_PACKAGE_QT5BASE_EGLFS=y
BR2_PACKAGE_QT5BASE_FONTCONFIG=y
BR2_PACKAGE_QT5BASE_GIF=y
BR2_PACKAGE_QT5BASE_JPEG=y
BR2_PACKAGE_QT5BASE_PNG=y
BR2_PACKAGE_QT5BASE_ICU=y
BR2_PACKAGE_QT5DECLARATIVE=y
BR2_PACKAGE_QT5DECLARATIVE_QUICK=y
BR2_PACKAGE_WPE_LAUNCHER=y
BR2_PACKAGE_INTELCE_SDK=y
BR2_PACKAGE_INTELCE_LOADDRIVERS=y
BR2_PACKAGE_INTELCE_SDK_V21=y
BR2_PACKAGE_INTELCE_BUFMON=y
BR2_PACKAGE_INTELCE_CONFIG_DATABASE=y
BR2_PACKAGE_INTELCE_DEMUX=y
BR2_PACKAGE_INTELCE_DIRECTFB_1_4=y
BR2_PACKAGE_INTELCE_EDL=y
BR2_PACKAGE_INTELCE_MUX=y
BR2_PACKAGE_INTELCE_PIC24=y
BR2_PACKAGE_INTELCE_PIC24_UART=y
BR2_PACKAGE_INTELCE_PIC24_UART_DRV=y
BR2_PACKAGE_INTELCE_REMUX=y
BR2_PACKAGE_INTELCE_TSOUT=y
BR2_PACKAGE_INTELCE_VIDDEC=y
BR2_PACKAGE_INTELCE_VIDENC=y
BR2_PACKAGE_INTELCE_VIDSINK=y
BR2_PACKAGE_JPEG_TURBO=y
BR2_PACKAGE_LIBDRM=y
BR2_PACKAGE_WPE=y
BR2_PACKAGE_WPE_USE_PUNCH_HOLE_GSTREAMER=y
BR2_PACKAGE_LIBPCIACCESS=y
BR2_PACKAGE_CPPSDK_DEBUG=y
BR2_PACKAGE_CPPSDK_DEVICES=y
BR2_PACKAGE_CPPSDK_PROCESS=y
BR2_PACKAGE_LIBATOMIC_OPS=y
BR2_PACKAGE_ICU_USE_ICUDATA=y
BR2_PACKAGE_PCRE_32=y
BR2_PACKAGE_DROPBEAR=y
BR2_PACKAGE_WEBBRIDGE=y
BR2_PACKAGE_PLUGIN_TRACECONTROL=y
BR2_PACKAGE_PLUGIN_DICTIONARY=y
BR2_PACKAGE_PLUGIN_BACKOFFICE=y
BR2_PACKAGE_PLUGIN_PROVISIONING=y
BR2_PACKAGE_PLUGIN_WEBPROXY=y
BR2_PACKAGE_PLUGIN_REMOTECONTROL=y
BR2_PACKAGE_PLUGIN_DEVICEINFO=y
BR2_PACKAGE_PLUGIN_WEBKITBROWSER=y
BR2_PACKAGE_PLUGIN_DIALSERVER=y
BR2_TARGET_ROOTFS_CPIO_GZIP=y
BR2_TARGET_ROOTFS_INITRAMFS=y
# BR2_TARGET_ROOTFS_TAR is not set
```

## configs/intel_wpe_defconfig
```kconfig
BR2_x86_i686=y
BR2_CCACHE=y
BR2_OPTIMIZE_2=y
BR2_KERNEL_HEADERS_VERSION=y
BR2_DEFAULT_KERNEL_VERSION="3.12.42"
BR2_PACKAGE_HOST_LINUX_HEADERS_CUSTOM_3_12=y
BR2_TOOLCHAIN_BUILDROOT_GLIBC=y
BR2_TOOLCHAIN_BUILDROOT_CXX=y
BR2_ENABLE_LOCALE_PURGE=y
BR2_ENABLE_LOCALE_WHITELIST="C en_US"
BR2_TARGET_GENERIC_CABUNDLE=y
BR2_ROOTFS_DEVICE_CREATION_DYNAMIC_EUDEV=y
BR2_TARGET_GENERIC_ROOT_PASSWD="root"
BR2_TARGET_GENERIC_GETTY_PORT="tty1"
BR2_SYSTEM_DHCP="eth0"
BR2_LINUX_KERNEL=y
BR2_LINUX_KERNEL_CUSTOM_GIT=y
BR2_LINUX_KERNEL_CUSTOM_REPO_URL="git@github.com:Metrological/linux-ice.git"
BR2_LINUX_KERNEL_CUSTOM_REPO_VERSION="master_31242"
BR2_LINUX_KERNEL_USE_CUSTOM_CONFIG=y
BR2_LINUX_KERNEL_CUSTOM_CONFIG_FILE="board/intel/intelce/linuxce-4200.config"
BR2_PACKAGE_BUSYBOX_SMP=y
BR2_PACKAGE_GSTREAMER1=y
BR2_PACKAGE_GSTREAMER1_GIT=y
BR2_PACKAGE_GST1_PLUGINS_BASE_PLUGIN_APP=y
BR2_PACKAGE_GST1_PLUGINS_BASE_PLUGIN_VIDEOCONVERT=y
BR2_PACKAGE_GST1_PLUGINS_BASE_PLUGIN_GIO=y
BR2_PACKAGE_GST1_PLUGINS_GOOD_PLUGIN_AUDIOFX=y
BR2_PACKAGE_GST1_PLUGINS_GOOD_PLUGIN_AUDIOPARSERS=y
BR2_PACKAGE_GST1_PLUGINS_GOOD_PLUGIN_AUTODETECT=y
BR2_PACKAGE_GST1_PLUGINS_GOOD_PLUGIN_DEINTERLACE=y
BR2_PACKAGE_GST1_PLUGINS_GOOD_PLUGIN_FLV=y
BR2_PACKAGE_GST1_PLUGINS_GOOD_PLUGIN_INTERLEAVE=y
BR2_PACKAGE_GST1_PLUGINS_GOOD_PLUGIN_SOUPHTTPSRC=y
BR2_PACKAGE_GST1_PLUGINS_BAD_PLUGIN_MPEGTSDEMUX=y
BR2_PACKAGE_GST1_PLUGINS_BAD_PLUGIN_VIDEOPARSERS=y
BR2_PACKAGE_GST1_PLUGINS_BAD_PLUGIN_DASH=y
BR2_PACKAGE_GST1_PLUGINS_BAD_PLUGIN_FAAD=y
BR2_PACKAGE_GST1_PLUGINS_BAD_PLUGIN_MPG123=y
BR2_PACKAGE_GST1_PLUGINS_BAD_PLUGIN_SMOOTHSTREAMING=y
BR2_PACKAGE_GST1_PLUGINS_BAD_PLUGIN_HLS=y
BR2_PACKAGE_TDITRACER=y
BR2_PACKAGE_NINJA=y
BR2_PACKAGE_DXDRM=y
BR2_PACKAGE_BITSTREAM_VERA=y
BR2_PACKAGE_INTELCE_LOADDRIVERS=y
BR2_PACKAGE_INTELCE_AUDIO=y
BR2_PACKAGE_INTELCE_BUFMON=y
BR2_PACKAGE_INTELCE_DEVMEM=y
BR2_PACKAGE_INTELCE_EXPBUS=y
BR2_PACKAGE_INTELCE_GRAPHICS_2D=y
BR2_PACKAGE_INTELCE_IDTS_CORE=y
BR2_PACKAGE_INTELCE_MSPOD=y
BR2_PACKAGE_INTELCE_MUX=y
BR2_PACKAGE_INTELCE_PIC24=y
BR2_PACKAGE_INTELCE_PIC24_UART=y
BR2_PACKAGE_INTELCE_PIC24_UART_DRV=y
BR2_PACKAGE_INTELCE_REMUX=y
BR2_PACKAGE_INTELCE_SEC_DIAGNOSE=y
BR2_PACKAGE_INTELCE_SEC_FW=y
BR2_PACKAGE_INTELCE_SMD_AVCAP_SHIM=y
BR2_PACKAGE_INTELCE_SOC_AUDIO=y
BR2_PACKAGE_INTELCE_THERMAL=y
BR2_PACKAGE_INTELCE_TSOUT=y
BR2_PACKAGE_INTELCE_VIDDEC=y
BR2_PACKAGE_INTELCE_VIDENC=y
BR2_PACKAGE_INTELCE_VIDSINK=y
# BR2_PACKAGE_EUDEV_ENABLE_HWDB is not set
BR2_PACKAGE_JPEG_TURBO=y
BR2_PACKAGE_LIBDRM_INTEL=y
BR2_PACKAGE_WPE=y
BR2_PACKAGE_WPE_USE_PUNCH_HOLE_GSTREAMER=y
BR2_PACKAGE_CPPSDK_DEBUG=y
BR2_PACKAGE_ORC=y
BR2_PACKAGE_ICU_USE_ICUDATA=y
BR2_PACKAGE_SHARED_MIME_INFO=y
BR2_PACKAGE_DROPBEAR=y
BR2_PACKAGE_GESFTPSERVER=y
BR2_PACKAGE_WEBBRIDGE=y
BR2_PACKAGE_PLUGIN_TRACECONTROL=y
BR2_PACKAGE_PLUGIN_DICTIONARY=y
BR2_PACKAGE_PLUGIN_DELAYEDRESPONSE=y
BR2_PACKAGE_PLUGIN_PROVISIONING=y
BR2_PACKAGE_PLUGIN_WEBPROXY=y
BR2_PACKAGE_PLUGIN_REMOTECONTROL=y
BR2_PACKAGE_PLUGIN_TEMPCONTROL=y
BR2_PACKAGE_PLUGIN_FILESERVER=y
BR2_PACKAGE_PLUGIN_DEVICEINFO=y
BR2_PACKAGE_PLUGIN_WEBKITBROWSER=y
BR2_PACKAGE_PLUGIN_DIALSERVER=y
```

## configs/qemu_x86_64_wpe_defconfig
```kconfig
BR2_x86_64=y
BR2_CCACHE=y
BR2_OPTIMIZE_2=y
BR2_PACKAGE_HOST_LINUX_HEADERS_CUSTOM_4_4=y
BR2_TOOLCHAIN_BUILDROOT_GLIBC=y
BR2_TOOLCHAIN_BUILDROOT_CXX=y
BR2_ENABLE_LOCALE_PURGE=y
BR2_ENABLE_LOCALE_WHITELIST="C en_US"
BR2_TARGET_GENERIC_CABUNDLE=y
BR2_ROOTFS_DEVICE_CREATION_DYNAMIC_EUDEV=y
BR2_TARGET_GENERIC_ROOT_PASSWD="root"
BR2_ROOTFS_USERS_TABLES="configs/qemu_x86_64_wpe_users_tables"
BR2_TARGET_GENERIC_GETTY_PORT="tty1"
BR2_SYSTEM_DHCP="eth0"
BR2_LINUX_KERNEL=y
BR2_LINUX_KERNEL_CUSTOM_VERSION=y
BR2_LINUX_KERNEL_CUSTOM_VERSION_VALUE="4.4.1"
BR2_LINUX_KERNEL_USE_CUSTOM_CONFIG=y
BR2_LINUX_KERNEL_CUSTOM_CONFIG_FILE="board/qemu/x86_64/linux-4.4.config"
BR2_PACKAGE_BUSYBOX_SMP=y
BR2_PACKAGE_GSTREAMER1=y
BR2_PACKAGE_GST1_PLUGINS_BASE_PLUGIN_APP=y
BR2_PACKAGE_GST1_PLUGINS_BASE_PLUGIN_VIDEOCONVERT=y
BR2_PACKAGE_GST1_PLUGINS_BASE_PLUGIN_GIO=y
BR2_PACKAGE_GST1_PLUGINS_GOOD_PLUGIN_AUDIOFX=y
BR2_PACKAGE_GST1_PLUGINS_GOOD_PLUGIN_AUDIOPARSERS=y
BR2_PACKAGE_GST1_PLUGINS_GOOD_PLUGIN_AUTODETECT=y
BR2_PACKAGE_GST1_PLUGINS_GOOD_PLUGIN_DEINTERLACE=y
BR2_PACKAGE_GST1_PLUGINS_GOOD_PLUGIN_INTERLEAVE=y
BR2_PACKAGE_GST1_PLUGINS_GOOD_PLUGIN_SOUPHTTPSRC=y
BR2_PACKAGE_GST1_PLUGINS_BAD_PLUGIN_MPEGTSDEMUX=y
BR2_PACKAGE_GST1_PLUGINS_BAD_PLUGIN_VIDEOPARSERS=y
BR2_PACKAGE_GST1_PLUGINS_BAD_PLUGIN_DASH=y
BR2_PACKAGE_GST1_PLUGINS_BAD_PLUGIN_FAAD=y
BR2_PACKAGE_GST1_PLUGINS_BAD_PLUGIN_MPG123=y
BR2_PACKAGE_GST1_PLUGINS_BAD_PLUGIN_SMOOTHSTREAMING=y
BR2_PACKAGE_GST1_PLUGINS_BAD_PLUGIN_HLS=y
BR2_PACKAGE_GST1_PLUGINS_BAD_LIB_OPENGL=y
BR2_PACKAGE_LIBSYSFS=y
BR2_PACKAGE_MESA3D=y
BR2_PACKAGE_LIBDRM=y
BR2_PACKAGE_LIBDRM_INTEL=y
BR2_PACKAGE_LIBDRM_RADEON=y
R2_PACKAGE_LIBDRM_AMDGPU=y
BR2_PACKAGE_LIBDRM_NOUVEAU=y
BR2_PACKAGE_LIBDRM_VMWGFX=y
BR2_PACKAGE_MESA3D_DRI_DRIVER=y
BR2_PACKAGE_MESA3D_OPENGL_EGL=y
BR2_PACKAGE_MESA3D_OPENGL_ES=y
BR2_PACKAGE_MESA3D_GALLIUM_DRIVER_SWRAST=y
BR2_PACKAGE_WAYLAND=y
BR2_PACKAGE_WESTON=y
BR2_PACKAGE_GST_OMX=y
BR2_PACKAGE_NINJA=y
BR2_PACKAGE_BITSTREAM_VERA=y
BR2_PACKAGE_WPE_LAUNCHER=y
# BR2_PACKAGE_EUDEV_ENABLE_HWDB is not set
BR2_PACKAGE_WPE=y
BR2_PACKAGE_ORC=y
BR2_PACKAGE_ICU_USE_ICUDATA=y
BR2_PACKAGE_SHARED_MIME_INFO=y
BR2_PACKAGE_DROPBEAR=y
BR2_PACKAGE_GESFTPSERVER=y
BR2_TARGET_ROOTFS_INITRAMFS=y
BR2_TARGET_ROOTFS_EXT2=y
BR2_PACKAGE_OPENSSH=y
BR2_PACKAGE_NANO=y
# BR2_TARGET_ROOTFS_TAR is not set
```

## package/intel-sdk/Config.in
```kconfig
config BR2_PACKAGE_INTELCESDK
	bool "Intel SDK"
	help
	  The Intel SDK for 

if BR2_PACKAGE_INTELCESDK
comment "IntelCE SDK"
	source package/intel-sdk/intel-sdk/Config.in
endif
```

## package/intel-sdk/intel-sdk/Config.in
```kconfig
menu "Intel SDK Package Selection"
	source "package/intel-sdk/package/Config.in"  
endmenu
```

## package/intel-sdk/package/intelce-api/Config.in
```kconfig
config BR2_PACKAGE_INTELCE_API
bool "api"
default n
select BR2_PACKAGE_INTELCE_SMD_COMMON
help
None
```

## package/intel-sdk/package/intelce-audio/Config.in
```kconfig
config BR2_PACKAGE_INTELCE_AUDIO
bool "audio"
default n
select BR2_PACKAGE_INTELCE_PAL
select BR2_PACKAGE_INTELCE_AUTO_EAS
select BR2_PACKAGE_INTELCE_OSAL
select BR2_PACKAGE_INTELCE_COMMON
select BR2_PACKAGE_INTELCE_SMD_TOOLS
select BR2_PACKAGE_INTELCE_SVEN
select BR2_PACKAGE_INTELCE_CORE
select BR2_PACKAGE_INTELCE_SMD_COMMON
select BR2_PACKAGE_INTELCE_API
select BR2_PACKAGE_INTELCE_PLATFORM_CONFIG
select BR2_PACKAGE_INTELCE_HTUPLE
select BR2_PACKAGE_INTELCE_CLOCK
select BR2_PACKAGE_INTELCE_CLOCK_RECOVERY
select BR2_PACKAGE_INTELCE_CLOCK_CONTROL
select BR2_PACKAGE_INTELCE_DISPLAY
select BR2_PACKAGE_INTELCE_AUDIO_FW
select BR2_PACKAGE_INTELCE_FW_LOAD
select BR2_PACKAGE_INTELCE_IOSF
select BR2_PACKAGE_INTELCE_AVCAP
select BR2_PACKAGE_INTELCE_INTEL_CE_PM
help
None
```

## package/intel-sdk/package/intelce-auto_eas/Config.in
```kconfig
config BR2_PACKAGE_INTELCE_AUTO_EAS
bool "auto_eas"
default n
select BR2_PACKAGE_INTELCE_SMD_COMMON
help
None
```

## package/intel-sdk/package/intelce-cefdk/Config.in
```kconfig
config BR2_PACKAGE_INTELCE_CEFDK
bool "cefdk"
default n
select BR2_PACKAGE_INTELCE_FLASH_ENCRYPTION_SIGNING_TOOLS
help
None
```

## package/intel-sdk/package/intelce-config_database/Config.in
```kconfig
config BR2_PACKAGE_INTELCE_CONFIG_DATABASE
bool "config_database"
default n
help
None
```

## package/intel-sdk/package/intelce-devmem/Config.in
```kconfig
config BR2_PACKAGE_INTELCE_DEVMEM
bool "devmem"
default n
select BR2_PACKAGE_INTELCE_PLATFORM_CONFIG
help
None
```

## package/intel-sdk/package/intelce-display/Config.in
```kconfig
config BR2_PACKAGE_INTELCE_DISPLAY
bool "display"
default n
select BR2_PACKAGE_INTELCE_API
select BR2_PACKAGE_INTELCE_AUTO_EAS
select BR2_PACKAGE_INTELCE_CLOCK_CONTROL
select BR2_PACKAGE_INTELCE_CORE
select BR2_PACKAGE_INTELCE_HDMI_HDCP
select BR2_PACKAGE_INTELCE_IDL
select BR2_PACKAGE_INTELCE_OSAL
select BR2_PACKAGE_INTELCE_PAL
select BR2_PACKAGE_INTELCE_PLATFORM_CONFIG
select BR2_PACKAGE_INTELCE_SYSTEM_UTILS
select BR2_PACKAGE_INTELCE_SVEN
select BR2_PACKAGE_INTELCE_GENERIC_TIMER
select BR2_PACKAGE_INTELCE_IOSF
select BR2_PACKAGE_FREETYPE
select BR2_PACKAGE_LIBPNG
select BR2_PACKAGE_ZLIB
select BR2_PACKAGE_INTELCE_INTEL_CE_PM
help
None
```

## package/intel-sdk/package/intelce-flash_encryption_signing_tools/Config.in
```kconfig
config BR2_PACKAGE_INTELCE_FLASH_ENCRYPTION_SIGNING_TOOLS
bool "flash_encryption_signing_tools"
default n
select BR2_PACKAGE_OPENSSL
help
None
```

## package/intel-sdk/package/intelce-graphics/Config.in
```kconfig
config BR2_PACKAGE_INTELCE_GRAPHICS
bool "graphics"
default n
select BR2_PACKAGE_INTELCE_OSAL
select BR2_PACKAGE_INTELCE_PAL
select BR2_PACKAGE_INTELCE_DISPLAY
select BR2_PACKAGE_INTELCE_FREEDESKTOP
select BR2_PACKAGE_INTELCE_BISON
select BR2_PACKAGE_INTELCE_FLEX
help
None
```

## package/intel-sdk/package/intelce-gsven/Config.in
```kconfig
config BR2_PACKAGE_INTELCE_GSVEN
bool "gsven"
default n
select BR2_PACKAGE_INTELCE_HTUPLE
select BR2_PACKAGE_INTELCE_AUTO_EAS
select BR2_PACKAGE_INTELCE_OSAL
select BR2_PACKAGE_INTELCE_PAL
select BR2_PACKAGE_INTELCE_PLATFORM_CONFIG
select BR2_PACKAGE_INTELCE_SMD_COMMON
select BR2_PACKAGE_INTELCE_SVEN
select BR2_PACKAGE_INTELCE_LIBVNCSERVER
select BR2_PACKAGE_INTELCE_IOSF
help
None
```

## package/intel-sdk/package/intelce-htuple/Config.in
```kconfig
config BR2_PACKAGE_INTELCE_HTUPLE
bool "htuple"
default n
select BR2_PACKAGE_INTELCE_SMD_COMMON
help
None
```
