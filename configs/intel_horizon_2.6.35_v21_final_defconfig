## package/intel-sdk/package/intelce-idl/Config.in
```kconfig
config BR2_PACKAGE_INTELCE_IDL
bool "idl"
default n
select BR2_PACKAGE_INTELCE_OSAL
select BR2_PACKAGE_INTELCE_PAL
select BR2_PACKAGE_INTELCE_GPIO
help
None
```

## package/intel-sdk/package/intelce-idts_common/Config.in
```kconfig
config BR2_PACKAGE_INTELCE_IDTS_COMMON
bool "idts_common"
default n
select BR2_PACKAGE_INTELCE_PAL
select BR2_PACKAGE_INTELCE_OSAL
select BR2_PACKAGE_INTELCE_IDL
select BR2_PACKAGE_OPENSSL
select BR2_PACKAGE_INTELCE_IDTSAL
help
None
```
