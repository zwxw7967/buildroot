## package/intel-sdk/package/intelce-idts_core/Config.in
```kconfig
config BR2_PACKAGE_INTELCE_IDTS_CORE
bool "idts_core"
default n
select BR2_PACKAGE_INTELCE_COMMON
select BR2_PACKAGE_INTELCE_HTUPLE
select BR2_PACKAGE_INTELCE_PAL
select BR2_PACKAGE_INTELCE_OSAL
select BR2_PACKAGE_INTELCE_IDL
select BR2_PACKAGE_INTELCE_API
select BR2_PACKAGE_INTELCE_FLASHTOOL
select BR2_PACKAGE_INTELCE_NAND_CONFIG
select BR2_PACKAGE_INTELCE_FLASH_APPDATA
select BR2_PACKAGE_INTELCE_CORE
select BR2_PACKAGE_INTELCE_CLOCK
select BR2_PACKAGE_INTELCE_CLOCK_CONTROL
select BR2_PACKAGE_INTELCE_CLOCK_RECOVERY
select BR2_PACKAGE_INTELCE_DEMUX
select BR2_PACKAGE_INTELCE_SVEN
select BR2_PACKAGE_INTELCE_PLATFORM_CONFIG
select BR2_PACKAGE_INTELCE_AUTO_EAS
select BR2_PACKAGE_INTELCE_CORE
select BR2_PACKAGE_INTELCE_IDTS_COMMON
select BR2_PACKAGE_INTELCE_MFHLIB
select BR2_PACKAGE_INTELCE_PWM
select BR2_PACKAGE_INTELCE_SYSTEM_UTILS
select BR2_PACKAGE_INTELCE_IDTSAL
help
None
```

## package/intel-sdk/package/intelce-idts_security/Config.in
```kconfig
config BR2_PACKAGE_INTELCE_IDTS_SECURITY
bool "idts_security"
default n
select BR2_PACKAGE_INTELCE_PAL
select BR2_PACKAGE_INTELCE_OSAL
select BR2_PACKAGE_INTELCE_NAND_CONFIG
select BR2_PACKAGE_INTELCE_FLASH_APPDATA
select BR2_PACKAGE_INTELCE_SEC
select BR2_PACKAGE_OPENSSL
select BR2_PACKAGE_INTELCE_IDTS_COMMON
select BR2_PACKAGE_INTELCE_IDTSAL
help
None
```

## package/intel-sdk/package/intelce-intel_ce_pm/Config.in
```kconfig
config BR2_PACKAGE_INTELCE_INTEL_CE_PM
bool "intel_ce_pm"
default n
select BR2_PACKAGE_INTELCE_PAL
select BR2_PACKAGE_INTELCE_OSAL
select BR2_PACKAGE_INTELCE_CLOCK_CONTROL
select BR2_PACKAGE_INTELCE_SYSTEM_UTILS
select BR2_PACKAGE_INTELCE_8051_SDK
select BR2_PACKAGE_INTELCE_IOSF
help
None
```

## package/intel-sdk/package/intelce-itstore/Config.in
```kconfig
config BR2_PACKAGE_INTELCE_ITSTORE
bool "itstore"
default n
select BR2_PACKAGE_INTELCE_SEC
select BR2_PACKAGE_INTELCE_OSAL
help
None
```

## package/intel-sdk/package/intelce-keyrefresh/Config.in
```kconfig
config BR2_PACKAGE_INTELCE_KEYREFRESH
bool "keyrefresh"
default n
select BR2_PACKAGE_INTELCE_SEC
help
None
```

## package/intel-sdk/package/intelce-nand_config/Config.in
```kconfig
config BR2_PACKAGE_INTELCE_NAND_CONFIG
bool "nand_config"
default n
select BR2_PACKAGE_INTELCE_OSAL
help
None
```

## package/intel-sdk/package/intelce-nsprpub_mw_dep/Config.in
```kconfig
config BR2_PACKAGE_INTELCE_NSPRPUB_MW_DEP
bool "nsprpub_mw_dep"
default n
select BR2_PACKAGE_INTELCE_NSPR
help
None
```

## package/intel-sdk/package/intelce-performancetools/Config.in
```kconfig
config BR2_PACKAGE_INTELCE_PERFORMANCETOOLS
bool "performancetools"
default n
help
None
```

## package/intel-sdk/package/intelce-pic24_uart/Config.in
```kconfig
config BR2_PACKAGE_INTELCE_PIC24_UART
bool "pic24_uart"
default n
select BR2_PACKAGE_INTELCE_OSAL
select BR2_PACKAGE_INTELCE_IDTS_COMMON
help
None
```

## package/intel-sdk/package/intelce-pic24_uart_drv/Config.in
```kconfig
config BR2_PACKAGE_INTELCE_PIC24_UART_DRV
bool "pic24_uart_drv"
default n
select BR2_PACKAGE_INTELCE_OSAL
select BR2_PACKAGE_INTELCE_INTEL_CE_PM
help
None
```

## package/intel-sdk/package/intelce-platform_config/Config.in
```kconfig
config BR2_PACKAGE_INTELCE_PLATFORM_CONFIG
bool "platform_config"
default n
select BR2_PACKAGE_INTELCE_HTUPLE
select BR2_PACKAGE_OPENSSL
help
None
```

## package/intel-sdk/package/intelce-punit_fw_upgrade/Config.in
```kconfig
config BR2_PACKAGE_INTELCE_PUNIT_FW_UPGRADE
bool "punit_fw_upgrade"
default n
select BR2_PACKAGE_INTELCE_IOSF
select BR2_PACKAGE_INTELCE_PAL
help
None
```

## package/intel-sdk/package/intelce-sec/Config.in
```kconfig
config BR2_PACKAGE_INTELCE_SEC
bool "sec"
default n
select BR2_PACKAGE_INTELCE_AUTO_EAS
select BR2_PACKAGE_INTELCE_OSAL
select BR2_PACKAGE_INTELCE_PAL
select BR2_PACKAGE_INTELCE_SVEN
select BR2_PACKAGE_INTELCE_CLOCK_CONTROL
select BR2_PACKAGE_INTELCE_SYSTEM_UTILS
select BR2_PACKAGE_INTELCE_INTEL_CE_PM
select BR2_PACKAGE_INTELCE_IOSF
help
None
```

## package/intel-sdk/package/intelce-thermal/Config.in
```kconfig
config BR2_PACKAGE_INTELCE_THERMAL
bool "thermal"
default n
select BR2_PACKAGE_INTELCE_OSAL
select BR2_PACKAGE_INTELCE_PAL
help
None
```

## package/intel-sdk/package/intelce-video_ces/Config.in
```kconfig
config BR2_PACKAGE_INTELCE_VIDEO_CES
bool "video_ces"
default n
select BR2_PACKAGE_INTELCE_SYSTEM_UTILS
select BR2_PACKAGE_INTELCE_PAL
select BR2_PACKAGE_INTELCE_AUTO_EAS
select BR2_PACKAGE_INTELCE_OSAL
select BR2_PACKAGE_INTELCE_HTUPLE
select BR2_PACKAGE_INTELCE_COMMON
select BR2_PACKAGE_INTELCE_SMD_TOOLS
select BR2_PACKAGE_INTELCE_SVEN
select BR2_PACKAGE_INTELCE_CORE
select BR2_PACKAGE_INTELCE_SMD_COMMON
select BR2_PACKAGE_INTELCE_API
select BR2_PACKAGE_INTELCE_PLATFORM_CONFIG
select BR2_PACKAGE_INTELCE_INTEL_CE_PM
select BR2_PACKAGE_INTELCE_SEC
select BR2_PACKAGE_INTELCE_FW_LOAD
help
None
```

## package/intelce-sdk/Config.in
```kconfig
source package/intelce-sdk/intelce-sdk/Config.in

if BR2_PACKAGE_INTELCE_SDK
    source package/intelce-sdk/intelce-loaddrivers/Config.in
	menu "Intel SDK Package Selection"
	    source "package/intelce-sdk/package/Config.in"  
    endmenu
endif
```

## package/smem/Config.in
```kconfig
config BR2_PACKAGE_SMEM
	bool "smem"
	help
		smem is a tool that can give numerous reports on memory usage on Linux systems. Unlike existing tools, smem can report proportional set size (PSS), which is a more meaningful representation of the amount of memory used by libraries and applications in a virtual memory system.
```
